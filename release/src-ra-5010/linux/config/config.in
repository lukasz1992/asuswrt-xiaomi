## release/src-ra-5010/linux/linux-3.10.14.x/arch/mips/ralink/Kconfig
```kconfig
if RALINK_RT2880

choice
        prompt "Soc Hardware Type"
	default RT2880_ASIC

config  RT2880_FPGA 
        bool "RT2880-FPGA"
config  RT2880_ASIC 
        bool "RT2880-ASIC"
endchoice

endif
#-----------------------------

if RALINK_RT2883

choice
        prompt "Soc Hardware Type"
	default RT2883_ASIC

config  RT2883_FPGA 
        bool "RT2883-FPGA"
config  RT2883_ASIC 
        bool "RT2883-ASIC"
endchoice

endif

#---------------------------

if RALINK_RT3052

choice
        prompt "Soc Hardware Type"
	default RT3052_ASIC

config  RT3052_FPGA 
        bool "RT305x/RT3350-FPGA"
config  RT3052_ASIC 
        bool "RT305x/RT3350-ASIC"
endchoice

config RALINK_RT3350
	bool "Ralink RT3350 chipset"

endif

#---------------------------

if RALINK_RT3352

choice
        prompt "Soc Hardware Type"
	default RT3352_ASIC

config  RT3352_FPGA 
	bool "RT3352-FPGA"
	select USB_ARCH_HAS_OHCI
	select USB_ARCH_HAS_EHCI

config  RT3352_ASIC 
	bool "RT3352-ASIC"
	select USB_ARCH_HAS_OHCI
	select USB_ARCH_HAS_EHCI

endchoice

endif

#--------------------------

if RALINK_RT3883

choice
        prompt "Soc Hardware Type"
	default RT3883_FPGA

config  RT3883_FPGA 
	bool "RT3883/RT3662-FPGA"
	select USB_ARCH_HAS_OHCI
	select USB_ARCH_HAS_EHCI

config  RT3883_ASIC 
	bool "RT3883/RT3662-ASIC"
	select USB_ARCH_HAS_OHCI
	select USB_ARCH_HAS_EHCI
endchoice

choice
        prompt "RT3883 PCI architecture"
	default PCIE_PCI_CONCURRENT

config PCIE_PCI_CONCURRENT
        bool "PCIE RC and PCI HOST CONCURRENT"
	select PCI
config PCIE_ONLY
        bool "PCIE RC ONLY"
	select PCI
config PCI_ONLY
        bool "PCI HOST ONLY"
	select PCI
config PCIE_PCI_NONE
        bool "Non-support PCI/PCIe"
endchoice

endif

#---------------------------

if RALINK_RT5350

choice
	prompt "Soc Hardware Type"
	default RT5350_ASIC

config	RT5350_FPGA 
	bool "RT5350-FPGA"
	select USB_ARCH_HAS_OHCI
	select USB_ARCH_HAS_EHCI

config	RT5350_ASIC 
	bool "RT5350-ASIC"
	select USB_ARCH_HAS_OHCI
	select USB_ARCH_HAS_EHCI

endchoice

endif

#--------------------------

if RALINK_RT6855

choice
        prompt "Soc Hardware Type"
	default RT6855_ASIC

config  RT6855_FPGA 
	bool "RT6855-FPGA"
	select USB_ARCH_HAS_OHCI
	select USB_ARCH_HAS_EHCI

config  RT6855_ASIC 
	bool "RT6855-ASIC"
	select USB_ARCH_HAS_OHCI
	select USB_ARCH_HAS_EHCI

endchoice

endif

#--------------------------

if RALINK_MT7620

choice
        prompt "Soc Hardware Type"
	default MT7620_ASIC

config  MT7620_FPGA 
	bool "MT7620-FPGA"
	select USB_ARCH_HAS_OHCI
	select USB_ARCH_HAS_EHCI

config  MT7620_ASIC 
	bool "MT7620-ASIC"
	select USB_ARCH_HAS_OHCI
	select USB_ARCH_HAS_EHCI

endchoice

endif

#--------------------------

if RALINK_MT7621

choice
        prompt "Soc Hardware Type"
	default MT7621_ASIC

config  MT7621_FPGA 
	bool "MT7621-FPGA"
	select USB_ARCH_HAS_HCD
	select USB_ARCH_HAS_XHCI

config  MT7621_ASIC 
	bool "MT7621-ASIC"
	select USB_ARCH_HAS_HCD
	select USB_ARCH_HAS_XHCI

endchoice

endif
#--------------------------

if RALINK_MT7628

choice
        prompt "Soc Hardware Type"
	default MT7628_ASIC

config  MT7628_FPGA 
	bool "MT7628-FPGA"
	select USB_ARCH_HAS_OHCI
	select USB_ARCH_HAS_EHCI

config  MT7628_ASIC 
	bool "MT7628-ASIC"
	select USB_ARCH_HAS_OHCI
	select USB_ARCH_HAS_EHCI

endchoice

endif

#--------------------------
config FLASH_REMAP_NEED
       bool
       default y if (RALINK_RT2880)
choice
       prompt "DRAM Size"
       default RT2880_DRAM_16M

config RT2880_DRAM_8M
       bool "8M"

config RT2880_DRAM_16M
       bool "16M"

config RT2880_DRAM_32M
       bool "32M"

config RT2880_DRAM_64M
       bool "64M"

config RT2880_DRAM_128M
       bool "128M"

config RT2880_DRAM_256M
       bool "256M"

config RT2880_DRAM_512M
       bool "512M"
       depends on  RALINK_MT7621
       select HIGHMEM

config RT2880_DRAM_1024M
       bool "1024M"
       depends on  RALINK_MT7621

endchoice


choice
       prompt "Flash Type"
       default MTD_ANY_RALINK

config MTD_NOR_RALINK
       bool "NOR"
       depends on  RALINK_RT3052 || RALINK_RT3883 || RALINK_MT2880

config MTD_SPI_RALINK
       bool "SPI"
       depends on  !RALINK_RT2880

config MTK_MTD_NAND
		bool "MTK_NAND"	
		depends on  RALINK_MT7621
		select MTD_NAND
		select MTD_NAND_IDS
		select MTD_NAND_ECC

config MTD_NAND_RALINK
       bool "NAND"
       depends on  !RALINK_RT3352 && !RALINK_RT2880 && !RALINK_RT5350 && !RALINK_MT7621 && !RALINK_MT7628

config MTD_ANY_RALINK
       bool "ANY (NOR/SPI/NAND)"
       depends on  !RALINK_RT3352 && !RALINK_RT5350 && !RALINK_MT7628
		select MTD_NAND
		select MTD_NAND_IDS
		select MTD_NAND_ECC

endchoice


choice
       prompt "Flash Size"
       default RT2880_FLASH_4M
#       depends on  FLASH_REMAP_NEED
       depends on  FLASH_REMAP_NEED || DUAL_IMAGE

config RT2880_FLASH_2M
       bool "2M"
       depends on  !DUAL_IMAGE

config RT2880_FLASH_4M
       bool "4M"

config RT2880_FLASH_8M
       bool "8M"

config RT2880_FLASH_16M
       bool "16M"

endchoice

config  DUAL_IMAGE
	bool 'Dual Image' 

config  KERNEL_NVRAM
	bool 'Kernel NVRAM'
	default n

#config  RT2880_FLASH_32M
#        bool "Flash Size 32MB Support"
#	depends on (RALINK_RT3052_MP2 || RALINK_RT3350) && !MTD_SPI_RALINK
#	select MTD_CONCAT if RT2880_FLASH_32M 

config  RALINK_RAM_SIZE
	int 
	default 8 if RT2880_DRAM_8M
	default 16 if RT2880_DRAM_16M
	default 32 if RT2880_DRAM_32M
	default 64 if RT2880_DRAM_64M
	default 128 if RT2880_DRAM_128M
	default 256 if RT2880_DRAM_256M
	default 512 if RT2880_DRAM_512M
	default 1024 if RT2880_DRAM_1024M

config MTD_PHYSMAP_START
       hex 
       default 0xBFC00000 if RT2880_FLASH_2M && !RALINK_RT3052
       default 0xBFC00000 if RT2880_FLASH_4M && !RALINK_RT3052
       default 0xBF400000 if RT2880_FLASH_8M && !RALINK_RT3052
       default 0xBEC00000 if RT2880_FLASH_16M && !RALINK_RT3052
       default 0xBF000000 if RT2880_FLASH_32M && !RALINK_RT3052
       default 0xBF000000 if !FLASH_REMAP_NEED && RALINK_RT3052
       default 0x1C000000 if !FLASH_REMAP_NEED && RALINK_RT3352
       default 0x1C000000 if !FLASH_REMAP_NEED && RALINK_RT5350
       default 0xBC000000 if !FLASH_REMAP_NEED && RALINK_RT2883
       default 0x1C000000 if !FLASH_REMAP_NEED && RALINK_RT3883
       default 0x1C000000 if !FLASH_REMAP_NEED && RALINK_RT6855
       default 0x1C000000 if !FLASH_REMAP_NEED && RALINK_MT7620
       default 0x1C000000 if !FLASH_REMAP_NEED && RALINK_MT7621
       default 0x1C000000 if !FLASH_REMAP_NEED && RALINK_MT7628

config MTD_PHYSMAP_LEN
       hex 
       default 0x200000 if RT2880_FLASH_2M
       default 0x400000 if RT2880_FLASH_4M
       default 0x800000 if RT2880_FLASH_8M
       default 0x1000000 if RT2880_FLASH_16M
       default 0x2000000 if RT2880_FLASH_32M
       default 0x1000000 if !FLASH_REMAP_NEED

config MTD_PHYSMAP_BUSWIDTH
       int 
       default 2

choice
	prompt "Root File System Type"
	default RT2880_ROOTFS_IN_RAM

config  RT2880_ROOTFS_IN_RAM
        bool "RootFS_in_RAM"
	select BLK_DEV_INITRD 
	select BLK_DEV_RAM 

config  RT2880_ROOTFS_IN_FLASH
        bool "RootFS_in_FLASH"
        depends on SUPPORT_OPENWRT
endchoice

config BLK_DEV_RAM_SIZE
	int 'Default RAM disk size'
	default 8192
	depends on RT2880_ROOTFS_IN_RAM


config ROOTFS_IN_FLASH_NO_PADDING
	bool 'No Padding between Kernel and RootFS'
	default n
	depends on !RT2880_ROOTFS_IN_FLASH && !RT2880_FLASH_32M && !DUAL_IMAGE

config MTD_KERNEL_PART_SIZ
	hex 'MTD Kernel Partition Size (Unit:Bytes)'
	default 0xD0000
	depends on RT2880_ROOTFS_IN_FLASH && !ROOTFS_IN_FLASH_NO_PADDING

config  RALINK_TIMER
	tristate 'Ralink Hardware Timer0/Timer1' 

config  RALINK_TIMER_DFS
        bool "Ralink Timer0"
        depends on RALINK_TIMER

config  RALINK_TIMER_WDG
        tristate "WatchDog Timer"
        depends on RALINK_TIMER

config  RALINK_TIMER_WDG_RESET_OUTPUT
        bool "Ralink WatchDog Reset Output"
        depends on RALINK_TIMER_WDG

config  RALINK_WDG_TIMER
        int "WatchDog Timer (Unit:1Sec, Max=30Sec)"
        default 10
        depends on RALINK_TIMER_WDG

config  RALINK_WDG_REFRESH_INTERVAL
        int "WatchDog Refresh Interval (Unit:1Sec, Max=30Sec)"
        default 4
        depends on RALINK_TIMER_WDG

config  RALINK_CPUSLEEP
	bool "Ralink CPU Sleep mode"
	select RALINK_SYSTICK
	depends on RALINK_MT7620 || RALINK_MT7621 || RALINK_MT7628
	default n

config  RALINK_SYSTICK
	bool "Ralink System Tick Counter"
	depends on RALINK_MT7620 || RALINK_MT7621 || RALINK_MT7628
	select GENERIC_CLOCKEVENTS_BROADCAST if RALINK_MT7621
	default n
```

## release/src-ra-5010/linux/linux-3.10.14.x/drivers/char/i2s/Kconfig
```kconfig
#
# Serial device configuration
#


menu "Ralink I2S"

source "drivers/char/i2s/codec/Kconfig"
source "drivers/char/i2s/core/Kconfig"

endmenu
```

## release/src-ra-5010/linux/linux-3.10.14.x/drivers/char/i2s/codec/Kconfig
```kconfig
#
# Serial device configuration
#
menuconfig RALINK_I2C_CODEC
	tristate "I2C-Codec controller"
#	select RALINK_I2C
	select MTK_I2C
	select I2C_MTK
#	select RALINK_GDMA
	default n

if RALINK_I2C_CODEC

choice
	prompt "Select codec to control"
	depends on RALINK_RT3883 || RALINK_RT3352 || RALINK_RT5350 || RALINK_RT6855 || RALINK_MT7620 || RALINK_MT7621 || RALINK_MT7628 || ARCH_MT7623
	default RALINK_I2C_WM8960

	config RALINK_I2C_WM8750
		bool "Support I2C-WM8750 control"
	config RALINK_I2C_WM8960
		bool "Support I2C-WM8960 control"
#	config I2S_192KHZ_CODEC
#		bool "Support 192KHz codec (WM8524 for Tx; WM8782 for RX)"
#		depends on RALINK_MT7628 || ARCH_MT7623
endchoice


config RALINK_I2C_WM8751
	bool "Select I2C-WM8751 control -- Support TX only"
	depends on RALINK_RT3052 || RALINK_RT2883 || RALINK_RT3350
	default y

endif
```

## release/src-ra-5010/linux/linux-3.10.14.x/drivers/char/i2s/core/Kconfig
```kconfig
#
# Serial device configuration
#


menuconfig RALINK_I2S
	tristate "Ralink I2S Support"
#	select RALINK_I2C
	select RALINK_GDMA
	default n

if RALINK_I2S

config I2S_IN_CLK
        bool "Use Internal Reference Clock"
	depends on RALINK_RT3052
	default n

config I2S_MS_MODE
        bool "Ralink SoC as I2S Master Device"
        depends on RALINK_RT3352 || RALINK_RT6855
	default n


config I2S_WM8751
	bool "Select Audio Codec WM8751  -- Support TX only"
	depends on RALINK_RT3052 || RALINK_RT2883 || RALINK_RT3350
	default y

config I2S_IN_MCLK
	bool "Use Internal REFCLK As MCLK Source"
	depends on RALINK_RT3352 || RALINK_RT5350 || RALINK_RT6855 || RALINK_MT7620 || RALINK_MT7621 || RALINK_MT7628 || ARCH_MT7623
	depends on !I2S_192KHZ_CODEC
	default y

config I2S_192KHZ_CODEC
		bool "Support 192KHz codec (WM8524 for Tx; WM8782 for RX)"
		depends on RALINK_MT7628 || ARCH_MT7623
		depends on !RALINK_I2C_CODEC


choice
	prompt	"Selection For MCLK"
	
	config I2S_MCLK_12MHZ
		bool "Select 12MHz Internal REFCLK"
		depends on RALINK_RT3352 || RALINK_RT5350 || RALINK_RT6855 || RALINK_MT7620 || RALINK_MT7628 || RALINK_MT7621
		depends on I2S_IN_MCLK
		depends on !I2S_192KHZ_CODEC

	config I2S_MCLK_12P288MHZ
		bool "Select 12.288MHz/11.289MHz Internal REFCLK as MCLK"
		depends on RALINK_MT7621 || ARCH_MT7623
		depends on I2S_IN_MCLK
		depends on !I2S_192KHZ_CODEC

	config I2S_MCLK_12MHZ
		bool "Select 12MHz External Xtal"
		depends on !I2S_IN_MCLK
		depends on !I2S_192KHZ_CODEC

	config I2S_MCLK_12P288MHZ
		bool "Select 12.288MHz External Xtal"
		depends on !I2S_IN_MCLK
		depends on !I2S_192KHZ_CODEC

	config I2S_MCLK_24P576MHZ
		bool "Select 24.576MHz External Xtal"
		depends on !I2S_IN_MCLK
		depends on I2S_192KHZ_CODEC

endchoice

#config I2S_MMAP
#        bool "Use MMAP mechanism for dma transmission"
#        depends on !SND_MT76XX_SOC
#        default y
#	---help---
#	  This option is supported while not turning on ALSA

#config I2S_WITH_AEC
#	tristate "Ralink I2S WITH AEC Support"
#	default n

endif #RALINK_I2S
```
